## config/boards/shields/reviung41lp/Kconfig.defconfig
```kconfig
# Copyright (c) 2020 The ZMK Contributors
# SPDX-License-Identifier: MIT

if SHIELD_REVIUNG41LP

config ZMK_KEYBOARD_NAME
    default "reviung41lp"

endif
```
